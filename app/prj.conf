## CMakeLists.txt
```
#-------------------------------------------------------------------------------
# Zephyr Example Application
#
# Copyright (c) 2021 Nordic Semiconductor ASA
# SPDX-License-Identifier: Apache-2.0

cmake_minimum_required(VERSION 3.13.1)

# Define the custom module for driver/library/Kconfig/Devicetree overlay.
# Must be done before finding the Zephyr package.
list(APPEND EXTRA_ZEPHYR_MODULES
  ${CMAKE_CURRENT_SOURCE_DIR}/../custom-module
)

find_package(Zephyr REQUIRED HINTS $ENV{ZEPHYR_BASE})

project(app LANGUAGES C)

target_sources(app PRIVATE src/main.c)
```

## sample.yaml
```
# This file is provided so that the application can be compiled using Twister,
# the Zephyr testing tool. In this file, multiple combinations can be specified,
# so that you can easily test all of them locally or in CI.
sample:
  description: Zephyr example application
  name: zephyr-example
common:
  build_only: true
  integration_platforms:
    - bbc_microbit_v2
tests:
  app.default: {}
  app.debug:
    extra_overlay_confs:
      - debug.conf
```

## prj.conf
```kconfig
# Copyright (c) 2021 Nordic Semiconductor ASA
# SPDX-License-Identifier: Apache-2.0
#
# This file contains selected Kconfig options for the application.

# Enable logging.
CONFIG_LOG=y

# Set logging level of the app and sub-components.
CONFIG_APP_LOG_LEVEL_INF=y
CONFIG_ACCELLIB_LOG_LEVEL_INF=y
CONFIG_LEDMATRIX_LOG_LEVEL_INF=y

# Enable floating point printk/logging.
CONFIG_PICOLIBC_IO_FLOAT=y

# Enable the accel lib.
CONFIG_ACCELLIB=y

# Enable the ledmatrix driver.
CONFIG_LEDMATRIX=y
```

## debug.conf
```kconfig
# Copyright (c) 2021 Nordic Semiconductor ASA
# SPDX-License-Identifier: Apache-2.0
#
# This is a Kconfig fragment which can be used to enable debug-related options
# in the application. See the README for more details.

# Compiler
CONFIG_DEBUG_OPTIMIZATIONS=y

# Logging
CONFIG_LOG=y
CONFIG_APP_LOG_LEVEL_DBG=y
CONFIG_ACCELLIB_LOG_LEVEL_DBG=y
CONFIG_LEDMATRIX_LOG_LEVEL_DBG=y
```

## boards/bbc_microbit_v2.overlay
```dts
/* This devicetree overlay file will be automatically picked by the Zephyr
 * build system when building the application for the bbc_microbit_v2 board.
 */

/ {
	/*
	 * Give an alias to the accelerometer to be used in the "accel" lib.
	 */
	aliases {
		accel = &lsm303agr_accel;
	};

	/*
	 * Define a node of the custom "custom-ledmatrix" binding that contains GPIO
	 * information from the 5x5 LED matrix. Provide the same GPIO pins as the
	 * "led_matrix" node in the bbc_microbit_v2 board devicetree source file.
	 */
	ledmatrix_label: custom_ledmatrix {
		compatible = "custom-ledmatrix";
		status = "okay";
		led-row-gpios = <&gpio0 21 GPIO_ACTIVE_HIGH>,
			        <&gpio0 22 GPIO_ACTIVE_HIGH>,
			        <&gpio0 15 GPIO_ACTIVE_HIGH>,
			        <&gpio0 24 GPIO_ACTIVE_HIGH>,
			        <&gpio0 19 GPIO_ACTIVE_HIGH>;
		led-col-gpios = <&gpio0 28 GPIO_ACTIVE_LOW>,
			        <&gpio0 11 GPIO_ACTIVE_LOW>,
			        <&gpio0 31 GPIO_ACTIVE_LOW>,
			        <&gpio1 5 GPIO_ACTIVE_LOW>,
			        <&gpio0 30 GPIO_ACTIVE_LOW>;
	};
};

/*
 * Configure the accelerometer via the lis2dh (i2c) binding. Here as an example,
 * simply repeat one of the default config.
 */ 
&lsm303agr_accel {
	anym-mode = <0>;
};
```

## src/main.c
```c
#include <zephyr/devicetree.h>
#include <zephyr/drivers/sensor.h>
#include <zephyr/kernel.h>
#include <zephyr/logging/log.h>


//!!
#include <zephyr/drivers/gpio.h>

#include "app_version.h"
#include "app/drivers/ledmatrix.h"
#include "app/lib/accel.h"

LOG_MODULE_REGISTER(main, CONFIG_APP_LOG_LEVEL);

#define MIN_GRAVITY_ACCEL 9

int main(void)
{
    int rc;
    const struct device *accel, *ledmatrix;
    struct accel_values accel_xyz;

    printk("Zephyr Example Application %s\n", APP_VERSION_STRING);

    accel = get_accel_device();
    if (accel == NULL) {
        return -1;
    }

    /*
     * An alternative to get the device:
     * DEVICE_DT_GET(DT_NODELABEL(ledmatrix_label))
     */
    ledmatrix = DEVICE_DT_GET(DT_PATH(custom_ledmatrix));
    if (ledmatrix == NULL) {
        LOG_ERR("Failed to get the LED matrix device");
        return -1;
    }

	while (1) {
        rc = get_accel_values(accel, &accel_xyz);

        if (rc != 0) {
            LOG_ERR("Failed to get accelerometer values: %d, retrying in 5 "
                    "seconds", rc);
            k_sleep(K_SECONDS(5));
            continue;
        }

        /* When turning the board on a side, the accelerometer will detect
         * gravity on its x or y axis instead of the z axis.
         * When the LED matrix is initially facing up, which is on the reverse
         * side of the accelerometer, below are the results of turning the
         * board sideways:
         * Left - negative X.
         * Right - positive X.
         * Up - positive Y.
         * Down - negative Y.
         * Detection of gravity will be in the above sequence, and 9m/s2 is used
         * as the threshold.
         */
        if (accel_xyz.x < -MIN_GRAVITY_ACCEL) {
            LOG_INF("The board was turned on its left side");
            ledmatrix_set_left_col(ledmatrix);
        } else if (accel_xyz.x > MIN_GRAVITY_ACCEL) {
            LOG_INF("The board was turned on its right side");
            ledmatrix_set_right_col(ledmatrix);
        } else if (accel_xyz.y > MIN_GRAVITY_ACCEL) {
            LOG_INF("The board was turned on its up side");
            ledmatrix_set_top_row(ledmatrix);
        } else if (accel_xyz.y < -MIN_GRAVITY_ACCEL) {
            LOG_INF("The board was turned on its down side");
            ledmatrix_set_bottom_row(ledmatrix);
        } else {
            ledmatrix_turn_off(ledmatrix);
        }

        k_sleep(K_SECONDS(1));
    }

    return 0;
}
```
