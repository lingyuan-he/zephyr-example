## custom-module/drivers/Kconfig
```kconfig
# Copyright (c) 2021 Nordic Semiconductor ASA
# SPDX-License-Identifier: Apache-2.0

menu "Custom Drivers"
rsource "ledmatrix/Kconfig"
endmenu
```

## custom-module/drivers/ledmatrix/Kconfig
```kconfig
# Copyright (c) 2024 Nordic Semiconductor ASA
# SPDX-License-Identifier: Apache-2.0

menuconfig LEDMATRIX
	bool "LED matrix device driver"
	help
	  This option enables the custom LED matrix driver.

if LEDMATRIX

config LEDMATRIX_INIT_PRIORITY
	int "LED matrix device driver init priority"
	default KERNEL_INIT_PRIORITY_DEVICE
	help
	  LED matrix device driver init priority.

module = LEDMATRIX
module-str = ledmatrix
source "subsys/logging/Kconfig.template.log_config"

endif # LEDMATRIX
```

## custom-module/dts/bindings/custom-led-matrix.yaml
```yaml
description: |
  An LED matrix that consists of row and column GPIO pins.

# Device tree node will have the same "compatible" attribute to be picked up
# by a driver that intends to operate on the device.
compatible: "custom-led-matrix"

include: base.yaml

properties:
  led-row-gpios:
    type: phandle-array
    required: true
    description: |
      Array of row GPIOs pins that are part of the matrix.

  led-col-gpios:
    type: phandle-array
    required: true
    description: |
      Array of column GPIOs pins that are part of the matrix.
```

## custom-module/dts/bindings/ledmatrix.yaml
```yaml
description: |
  An LED matrix that consists of row and column GPIO pins.

# Device tree node will have the same "compatible" attribute.
compatible: "ledmatrix"

include: base.yaml

properties:
  row-gpio-pins:
    type: phandle-array
    required: true
    description: |
      Array of row GPIOs pins that are part of the matrix.

  col-gpio-pins:
    type: phandle-array
    required: true
    description: |
      Array of column GPIOs pins that are part of the matrix.
```

## custom-module/lib/accel/Kconfig
```kconfig
# Custom lib Kconfig

menuconfig ACCELLIB
	bool "Support for custom accelerometer library"
	help
	  This option enables the custom accelerometer library.

if ACCELLIB

module = ACCELLIB
module-str = accellib
source "subsys/logging/Kconfig.template.log_config"

endif # ACCELLIB
```
